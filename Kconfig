## Kconfig
```kconfig
config TOUCHSCREEN_DURATOUCH
	tristate "UICO DuraTouch touchscreen"
	depends on I2C
	help
	  Say Y here to enable support for the UICO Duratouch
	  series touchscreen controller.

	  If unsure, say N.

	  To compile this driver as module, choose M here: the
	  module will be called duraTOUCH
```
